## meta-ypdd/conf/layer.conf
```bitbake
# We have a conf and classes directory, add to BBPATH
BBPATH .= ":${LAYERDIR}"

# We have recipes-* directories, add to BBFILES
BBFILES += "${LAYERDIR}/recipes-*/*/*.bb \
            ${LAYERDIR}/recipes-*/*/*.bbappend \
           "

BBFILE_COLLECTIONS += "meta-ypdd"
BBFILE_PATTERN_meta-ypdd = "^${LAYERDIR}/"
BBFILE_PRIORITY_meta-ypdd = "6"

LAYERDEPENDS_meta-ypdd = "core"
LAYERSERIES_COMPAT_meta-ypdd = "nanbield"

OE_TERMINAL = "screen"
```
